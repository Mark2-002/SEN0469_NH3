// To get started, press Ctrl+Space to bring up the completion menu and view the available nodes.

// You can also use the buttons in the sidebar to perform actions on nodes.
// Actions currently available include:

// * Enabling / disabling the node
// * Adding the bus to a bus
// * Removing the node
// * Connecting ADC channels

// For more help, browse the DeviceTree documentation at https://docs.zephyrproject.org/latest/guides/dts/index.html
// You can also visit the nRF DeviceTree extension documentation at https://nrfconnect.github.io/vscode-nrf-connect/devicetree/nrfdevicetree.html
&uart0 {
	status = "okay";
	current-speed = < 9600 >; /* Default 115200 */
};


// &pinctrl {
//     uart0_default: uart0_default {
//         group1 {
//             psels = <NRF_PSEL(UART_TX, 0, 24)>,
//                 <NRF_PSEL(UART_RX, 0, 23)>,
//                 <NRF_PSEL(UART_RTS, 0, 5)>,
//                 <NRF_PSEL(UART_CTS, 0, 7)>;
//         };
//     };

//     uart0_sleep: uart0_sleep {
//         group1 {
//             psels = <NRF_PSEL(UART_TX, 0,24)>,
//                 <NRF_PSEL(UART_RX, 0, 23)>,
//                 <NRF_PSEL(UART_RTS, 0, 5)>,
//                 <NRF_PSEL(UART_CTS, 0, 7)>;
//             low-power-enable;
//         };
//     };
// };









// ////////////////////////For 52833 node


// /{leds {
//     compatible = "gpio-leds";
//     led0: led_0 {
//         gpios = <&gpio0 4 GPIO_ACTIVE_LOW>;
//         label = "Green LED 0";
//     };
//     led1: led_1 {
//         gpios = <&gpio0 5 GPIO_ACTIVE_LOW>;
//         label = "Green LED 1";
//     };
//     led2: led_2 {
//         gpios = <&gpio1 9 GPIO_ACTIVE_LOW>;
//         label = "Green LED 2";
//     };
//     led3: led_3 {
//         gpios = <&gpio0 29 GPIO_ACTIVE_LOW>;
//         label = "LIS3DH";
//     };
// };
// aliases {
//     led0 = &led0;
//     led1 = &led1;
//     led2 = &led2;
//     led3 = &led3;
// };
// };
// &i2c0 {
// compatible = "nordic,nrf-twi";
// status = "okay";
// pinctrl-0 = <&i2c0_default>;
// pinctrl-1 = <&i2c0_sleep>;
// pinctrl-names = "default", "sleep";
// };
// &pinctrl {
// i2c0_default: i2c0_default {
//     group1 {
//         psels = <NRF_PSEL(TWIM_SDA, 0, 2)>,
//                 <NRF_PSEL(TWIM_SCL, 0, 3)>;
//     };
// };

// i2c0_sleep: i2c0_sleep {
//     group1 {
//         psels = <NRF_PSEL(TWIM_SDA, 0, 2)>,
//                 <NRF_PSEL(TWIM_SCL, 0, 3)>;
//         low-power-enable;
//     };
// };
// uart0_default: uart0_default {
//     group1 {
//         psels = <NRF_PSEL(UART_TX, 0, 15)>;		
//     };
//     group2 {
//         psels = <NRF_PSEL(UART_RX, 0,17)>;		
//         bias-pull-up;
//     };
// };

// uart0_sleep: uart0_sleep {
//     group1 {
//         psels = <NRF_PSEL(UART_TX, 0, 15)>,
//             <NRF_PSEL(UART_RX, 0, 17)>;
//         low-power-enable;
//     };
// };
// };